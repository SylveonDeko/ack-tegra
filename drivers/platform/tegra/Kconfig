## drivers/platform/tegra/Kconfig
```kconfig
# SPDX-License-Identifier: GPL-2.0-only
#
# Tegra Platform Specific Drivers
#

menuconfig TEGRA_PLATFORM_DEVICES
	bool "Tegra Platform Specific Device Drivers"
	default y
	help
	  Say Y here to get to see options for device drivers of various
	  Tegra platforms. This option itself does not add any kernel code.

	  If you say N, all options in this submenu will be skipped and
	  disabled.

if TEGRA_PLATFORM_DEVICES

config TEGRA_PROD_LEGACY
	def_bool y
	help
	  This config helps client driver to identify whether prod
	  framework is implemented as legacy method or not.

endif # TEGRA_PLATFORM_DEVICES
```
